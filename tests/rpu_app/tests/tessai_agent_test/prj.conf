## CMakeLists.txt
```
# SPDX-License-Identifier: Apache-2.0
# Copyright (C) 2026 Advanced Micro Devices, Inc. All rights reserved.
#
# Link A acceptance target. Builds a minimal RPURuntime ELF whose only
# job is to come up, run apu_rpmsg_platform.c's SYS_INIT, register the
# "tessai-agent" rpmsg endpoint, and then idle. The APU side
# (tessai-agent kernel driver + tessai_agent_unittest binary) drives
# all traffic; the RPU just responds.
#
# CONFIG_TESSAI_APU_RPMSG_SLAVE=y in prj.conf is what actually turns
# on the link A transport + endpoint compilation in
# src/driver/CMakeLists.txt.

cmake_minimum_required(VERSION 3.20.0)

set(COMMON_DIR ${CMAKE_CURRENT_SOURCE_DIR}/../common)

# Pull the driver in as a Zephyr module so apu_rpmsg_platform.c
# and tessai_agent_endpoint.c are eligible for compilation when
# CONFIG_TESSAI_APU_RPMSG_SLAVE=y (set in this target's prj.conf).
set(TESSAI_DRIVER_DIR ${CMAKE_CURRENT_SOURCE_DIR}/../../src/driver/)
list(APPEND ZEPHYR_EXTRA_MODULES ${TESSAI_DRIVER_DIR})

# Layer: common/prj.conf base, then this target's prj.conf overlay
# (which flips TESSAI_APU_RPMSG_SLAVE on).
set(CONF_FILE     ${COMMON_DIR}/prj.conf)
set(OVERLAY_CONFIG ${CMAKE_CURRENT_SOURCE_DIR}/prj.conf)

# Devicetree overlay. Zephyr's auto-pickup keys on
# boards/<BOARD>.overlay; we use a board-independent name so plug it
# in explicitly here.
set(DTC_OVERLAY_FILE ${CMAKE_CURRENT_SOURCE_DIR}/boards/rpu.overlay)

find_package(Zephyr REQUIRED HINTS $ENV{ZEPHYR_BASE})
project(tessai_agent_test LANGUAGES C)

# Place the zephyr/lib/open-amp/resource_table.c output's
# .resource_table section into the RSC_TABLE memory-region
# (apu_rsctbl @ 0x0A000000, see reserved.dtsi Section D).
#
# Zephyr 3.7 on cortex-r52 uses the preprocessor-based linker script
# pipeline, NOT the CMake linker generator. The idiomatic path is
# `zephyr_linker_sources(SECTIONS ...)` which appends a .ld fragment
# into the SECTIONS slot at the end of the generated linker.cmd.
# Without this, ld orphan-places .resource_table somewhere in RAM and
# the RSC_TABLE region stays empty.
zephyr_linker_sources(SECTIONS linker/resource_table.ld)

target_sources(app PRIVATE src/main.c)
```

## prj.conf
```kconfig
# SPDX-License-Identifier: Apache-2.0
# Copyright (C) 2026 Advanced Micro Devices, Inc. All rights reserved.
#
# Phase 1 link A overlay. Layered on top of tests/common/prj.conf
# (CPP, libcpp, USERSPACE, heap, clock WA, logging, stack sizes).

# Enable link A slave transport + tessai endpoint compilation.
# src/driver/CMakeLists.txt gates apu_rpmsg_platform.c and
# tessai_agent_endpoint.c on this single switch; their SYS_INIT
# hooks then auto-register the endpoint at APPLICATION priority.
CONFIG_TESSAI_APU_RPMSG_SLAVE=y

# This target is C-only; turn off the heavy C++ pulled in by
# tests/common/prj.conf for the XRT-lite tests.
CONFIG_CPP=n
CONFIG_STD_CPP17=n
CONFIG_REQUIRES_FULL_LIBCPP=n
CONFIG_CPP_EXCEPTIONS=n

# Phase-1 noise floor: enable tessai driver debug printk so link A
# init and tessai endpoint registration land in the RPU console —
# easy pass/fail signal in the boot log.
CONFIG_TESSAI_VERBOSE=y
```

## boards/rpu.overlay
```dts
// SPDX-License-Identifier: Apache-2.0
// Copyright (C) 2026 Advanced Micro Devices, Inc. All rights reserved.

/*
 * Link A acceptance overlay.
 *
 * The stock upstream R52 board sets chosen.zephyr,sram to
 * /memory@00000000 (NoC DDR @ 0x00100000), which is fine for JTAG/XSDB
 * boot but is rejected by Linux remoteproc when rproc1 tries to load
 * the ELF: the kernel-side carveout ddrboot@0a000000 (1 MiB, injected
 * by apply_tessai_patch.py) doesn't cover 0x00100000. Re-pointing
 * zephyr,sram at &apu_rpmsg_fw (reserved.dtsi Section D) links
 * RPURuntime's loadable text/data into the carveout Linux already
 * reserves for rproc1. .resource_table stays at apu_rsctbl (OCM Bank 1,
 * 0xBBF80000), matching kernel-DT rsc_tbl_carveout_1.
 *
 * The compatible re-narrow on &apu_rpmsg_fw drops the
 * zephyr,memory-region binding so making it the main SRAM doesn't
 * also emit a duplicate MEMORY block / burn an extra MPU slot.
 *
 * Boundary contract (do not break in isolation):
 *   apu_rpmsg_fw.reg      == ddrboot@a000000 kernel carveout
 *                            (reg = <0x00 0x0a000000 0x00 0x100000>)
 *   apu_rsctbl.reg        == rsc_tbl_carveout_1
 *   apu_rpmsg_shmem.reg   == rpu1vdev0vring0/1 + rpu1vdev0buffer cluster
 */

&apu_rpmsg_fw {
	compatible = "mmio-sram";
	/delete-property/ zephyr,memory-region;
	/delete-property/ zephyr,memory-attr;
};

/ {
	chosen {
		zephyr,sram = &apu_rpmsg_fw;
	};
};
```

## src/main.c
```c
/*
 * SPDX-License-Identifier: Apache-2.0
 * Copyright (C) 2026 Advanced Micro Devices, Inc. All rights reserved.
 *
 * Phase 1 link A acceptance: passive main.
 *
 * apu_rpmsg_platform.c (SYS_INIT APPLICATION) brings up the link A
 * OpenAMP slave transport against the apu_rsctbl / apu_rpmsg_shmem
 * carveouts and the ipi_2_to_ipi_3 mailbox, then
 * tessai_agent_endpoint.c (SYS_INIT APPLICATION +10) registers the
 * "tessai-agent" rpmsg endpoint and starts its RX worker.
 *
 * Once SYS_INIT finishes Zephyr enters main(); we have nothing to do
 * here beyond logging "ready" and parking on k_sleep so the kernel
 * keeps the endpoint workers and the link A RX thread alive. The APU
 * side drives all traffic.
 */

#include <zephyr/kernel.h>
#include <zephyr/logging/log.h>

LOG_MODULE_REGISTER(tessai_agent_test, LOG_LEVEL_INF);

int main(void)
{
	LOG_INF("Phase 1 RPURuntime up: link A tessai-agent endpoint ready");
	LOG_INF("Idling main(); SYS_INIT brought up apu_rpmsg + tessai endpoint");

	for (;;) {
		k_sleep(K_FOREVER);
	}

	return 0;
}
```
